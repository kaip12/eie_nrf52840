## CMakeLists.txt
```
#-------------------------------------------------------------------------------
# Zephyr Example Application
#
# Copyright (c) 2021 Nordic Semiconductor ASA
# SPDX-License-Identifier: Apache-2.0

cmake_minimum_required(VERSION 3.13.1)
find_package(Zephyr REQUIRED HINTS $ENV{ZEPHYR_BASE})

project(app LANGUAGES C)

zephyr_include_directories(src)

target_sources(app PRIVATE src/main.c)
target_soruces(app PRIVATE src/my_state_machine.c)
```

## prj.conf
```kconfig
# Copyright (c) 2021 Nordic Semiconductor ASA
# SPDX-License-Identifier: Apache-2.0
#
# This file contains selected Kconfig options for the application.

CONFIG_GPIO=y
CONFIG_SMF =y
```

## src/main.c
```c
/*
 * main.c
 */

#include <inttypes.h>

#include <zephyr/kernel.h>
#include <zephyr/sys/printk.h>

#include "BTN.h"
#include "LED.h"

#define SLEEP_MS 1

#include "BTN.h"
#include "LED.h"

#ifndef LED0
#define LED0 0
#endif

#define SLEEP_MS 50  /* small delay to debounce button polling */

int main(void) {
    int ret;

    if (0 > BTN_init()) {
        return 0;
    }
    if (0 > LED_init()) {
        return 0;
    }

    while (1) {
        if (BTN_check_clear_pressed(BTN0)) {
            LED_toggle(LED0);
            printk("Button 0 pressed!\n");
        }
        k_msleep(SLEEP_MS);
    }

    return 0;
}
```

## src/my_state_machine.c
```c
/**
 * @file my_state_machine.c
 */

 #include <zephyr/smf.h>
 #include "LED.h"
 #include "my_state_machine.h"

/*
 * FUCNTION PROTOTYPES
 */
static void led_on_state_entry(void* o);
static enum smf_state_result led_on_state_run(void* o);
static void led_off_state_entry(void* o);
static enum smf_state_result led_off_state_run(void* o);

 /*
  *Typedefs
 */
enum led_state_machine_states{
    LED_ON_STATE,
    LED_OFF_STATE
};
typedef struct {
    struct smf_ctx ctx;

    uint16_t count;
} led_state_object_t;

/*
 * LOCAL VARIABLES
 */
static const struct smf_state led_states[] = {
    [LED_ON_STATE] = SMF_CREATE_STATE(led_on_state_entry, led_on_state_run, NULL, NULL, NULL),
    [LED_OFF_STATE] = SMF_CREATE_STATE(led_off_state_entry, led_off_state_run, NULL, NULL, NULL)
};

static led_state_object_t led_state_object;

 void state_machine_init(){
    led_state_object.count = 0;
    smf_set_initial(SMF_CTX(&led_state_object), &led_states[LED_ON_STATE]);
 }

 int state_machine_run(){
    return smf_run_state(SMF_CTX(&led_state_object));
 }

 static void led_on_state_entry(void* o){
    LED_set(LED0, LED_ON);
 }

 static enum smf_state_result led_on_state_run(void* o){
    if(led_state_object.count > 500){
        led_state_object.count = 0;
        smf_set_state(SMF_CTX(&led_state_object), &led_states[LED_OFF_STATE]);
    } else {
        led_state_object.count++;
    }
    return SMF_EVENT_HANDLED;
 }

 static void led_off_state_entry(void* o){
    LED_set(LED0, LED_OFF);
 }
 
 static enum smf_state_result led_off_state_run(void* o){
    if (led_state_object.count > 500){
        led_state_object.count = 0;
        smf_set_state(SMF_CTX(&led_state_object), &led_states[LED_ON_STATE]);
    } else {
        led_state_object.count++;
    }
    return SMF_EVENT_HANDLED;
 }
```
